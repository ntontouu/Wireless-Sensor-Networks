/*
========================================================
 ΑΣΥΡΜΑΤΟΣ ΚΟΜΒΟΣ ΑΙΣΘΗΤΗΡΑ ESP-NOW - ESP32-C6 - DHT11
 ΕΡΓΑΣΤΗΡΙΟ ΑΣΥΡΜΑΤΩΝ ΔΙΚΤΥΩΝ ΑΙΣΘΗΤΗΡΩΝ
 ΜΑΡΙΑ ΑΛΕΞΑΝΔΡΑ ΝΤΟΝΤΟΥ
 ΑΜ: 2799
========================================================

 ΠΕΡΙΓΡΑΦΗ:
 ΤΟ ESP32-C6 ΛΕΙΤΟΥΡΓΕΙ ΩΣ ΤΕΛΙΚΟΣ ΚΟΜΒΟΣ ESP-NOW
 ΚΑΙ ΜΕΤΑΔΙΔΕΙ ΠΕΡΙΟΔΙΚΑ ΜΕΤΡΗΣΕΙΣ ΑΙΣΘΗΤΗΡΑ
 ΣΕ ΕΝΑΝ ΚΟΜΒΟ ΣΥΝΤΟΝΙΣΤΗ (COORDINATOR).

 ΕΠΙΚΟΙΝΩΝΙΑ:
 - ΠΡΩΤΟΚΟΛΛΟ: ESP-NOW
 - ΛΕΙΤΟΥΡΓΙΑ: WI-FI STATION (STA)
 - ΜΕΤΑΔΟΣΗ: BROADCAST

 ΠΕΡΙΕΧΟΜΕΝΑ ΠΑΚΕΤΟΥ:
 - NODE ID
 - ΜΕΤΡΗΤΗΣ ΠΑΚΕΤΩΝ
 - 4 ΤΙΜΕΣ ΚΙΝΗΤΗΣ ΥΠΟΔΙΑΣΤΟΛΗΣ (FLOAT)
 - 2 ΑΚΕΡΑΙΕΣ ΤΙΜΕΣ (INT)
 - 2 ΣΗΜΑΙΕΣ (BOOLEAN)
 - ΠΕΔΙΟ ΚΕΙΜΕΝΟΥ

 ΑΝΤΙΣΤΟΙΧΙΣΗ ΓΙΑ ΤΟΝ ΚΟΜΒΟ 15:
 VALUE1 -> ΘΕΡΜΟΚΡΑΣΙΑ (DHT11)
 VALUE2 -> ΥΓΡΑΣΙΑ (DHT11)
 VALUE3 -> ΚΕΝΟ (0.0)
 VALUE4 -> ΚΕΝΟ (0.0)
 INT1   -> ΑΘΡΟΙΣΜΑ ΕΛΕΓΧΟΥ (CHECKSUM)
 INT2   -> ΙΣΧΥΣ ΣΗΜΑΤΟΣ (RSSI)

 ΑΝΑΠΤΥΧΘΗΚΕ ΓΙΑ ΤΟ ΜΑΘΗΜΑ:
 ΔΙΚΤΥΑ ΑΙΣΘΗΤΗΡΩΝ

 ΥΛΙΚΟ:
 - ESP32-C6 DEVKIT
 - ΑΙΣΘΗΤΗΡΑΣ DHT11
========================================================
*/
#include <esp_now.h> // ΕΙΣΑΓΩΓΗ ΒΙΒΛΙΟΘΗΚΗΣ ΓΙΑ ΤΟ ΑΣΥΡΜΑΤΟ ΠΡΩΤΟΚΟΛΛΟ ESP-NOW
#include <WiFi.h>    // ΕΙΣΑΓΩΓΗ ΒΙΒΛΙΟΘΗΚΗΣ ΓΙΑ ΤΗ ΧΡΗΣΗ ΤΗΣ ΚΕΡΑΙΑΣ WI-FI
#include <DHT.h>     // ΕΙΣΑΓΩΓΗ ΒΙΒΛΙΟΘΗΚΗΣ ΓΙΑ ΤΟΝ ΑΙΣΘΗΤΗΡΑ ΘΕΡΜΟΚΡΑΣΙΑΣ ΚΑΙ ΥΓΡΑΣΙΑΣ

// ΟΡΙΣΜΟΣ ΑΚΡΟΔΕΚΤΩΝ (PINS) ΓΙΑ ΤΟΥΣ ΑΙΣΘΗΤΗΡΕΣ
#define DHTPIN 4         // ΟΡΙΣΜΟΣ ΤΟΥ PIN 4 ΓΙΑ ΤΟ ΚΑΛΩΔΙΟ ΔΕΔΟΜΕΝΩΝ ΤΟΥ ΑΙΣΘΗΤΗΡΑ DHT11
#define DHTTYPE DHT11    // ΚΑΘΟΡΙΣΜΟΣ ΤΟΥ ΑΚΡΙΒΟΥΣ ΤΥΠΟΥ ΤΟΥ ΑΙΣΘΗΤΗΡΑ DHT

// ΔΗΜΙΟΥΡΓΙΑ ΑΝΤΙΚΕΙΜΕΝΟΥ DHT
DHT dht(DHTPIN, DHTTYPE); // ΑΡΧΙΚΟΠΟΙΗΣΗ ΤΟΥ ΑΙΣΘΗΤΗΡΑ ΜΕ ΤΟ ΟΡΙΣΜΕΝΟ PIN ΚΑΙ ΤΥΠΟ

// ΑΠΟΘΗΚΕΥΣΗ ΜΕΤΡΗΤΗ ΠΑΚΕΤΩΝ ΣΤΗ ΜΝΗΜΗ RTC ΓΙΑ ΝΑ ΕΠΙΒΙΩΝΕΙ ΣΤΟ DEEP SLEEP
RTC_DATA_ATTR uint32_t rtc_packet_counter = 0; 

uint32_t start_time; // ΜΕΤΑΒΛΗΤΗ ΓΙΑ ΤΗΝ ΑΠΟΘΗΚΕΥΣΗ ΤΗΣ ΑΚΡΙΒΟΥΣ ΣΤΙΓΜΗΣ ΠΟΥ ΞΥΠΝΑΕΙ Η ΣΥΣΚΕΥΗ

// ΔΙΕΥΘΥΝΣΗ BROADCAST
uint8_t broadcastAddress[] = {0xFF,0xFF,0xFF,0xFF,0xFF,0xFF}; 

// ΔΟΜΗ ΠΑΚΕΤΟΥ
typedef struct struct_message {
    uint8_t node_id;         // ΑΡΙΘΜΟΣ ΑΝΑΓΝΩΡΙΣΗΣ ΑΥΤΗΣ ΤΗΣ ΣΥΓΚΕΚΡΙΜΕΝΗΣ ΣΥΣΚΕΥΗΣ
    uint32_t packet_counter; // ΠΟΣΑ ΠΑΚΕΤΑ ΕΧΟΥΜΕ ΣΤΕΙΛΕΙ ΜΕΧΡΙ ΤΩΡΑ
    float value1;            // ΜΕΤΑΒΛΗΤΗ ΓΙΑ ΤΗΝ ΑΠΟΘΗΚΕΥΣΗ ΤΗΣ ΘΕΡΜΟΚΡΑΣΙΑΣ
    float value2;            // ΜΕΤΑΒΛΗΤΗ ΓΙΑ ΤΗΝ ΑΠΟΘΗΚΕΥΣΗ ΤΗΣ ΥΓΡΑΣΙΑΣ
    float value3;            // ΕΞΤΡΑ ΜΕΤΑΒΛΗΤΗ, ΠΑΡΑΜΕΝΕΙ ΣΤΟ ΜΗΔΕΝ
    float value4;            // ΕΞΤΡΑ ΜΕΤΑΒΛΗΤΗ, ΠΑΡΑΜΕΝΕΙ ΣΤΟ ΜΗΔΕΝ
    int32_t int1;            // ΜΕΤΑΒΛΗΤΗ ΓΙΑ ΤΗΝ ΑΠΟΘΗΚΕΥΣΗ ΤΟΥ ΑΘΡΟΙΣΜΑΤΟΣ ΕΛΕΓΧΟΥ (CHECKSUM)
    int32_t int2;            // ΜΕΤΑΒΛΗΤΗ ΓΙΑ ΤΗΝ ΙΣΧΥ ΤΟΥ ΣΗΜΑΤΟΣ (RSSI)
    bool flag1;              // ΑΠΛΗ ΜΕΤΑΒΛΗΤΗ TRUE/FALSE (ΠΑΝΤΑ TRUE ΕΔΩ)
    bool flag2;              // ΑΠΛΗ ΜΕΤΑΒΛΗΤΗ TRUE/FALSE (ΠΑΝΤΑ FALSE ΕΔΩ)
    char text[16];           // ΠΙΝΑΚΑΣ ΧΑΡΑΚΤΗΡΩΝ ΓΙΑ ΤΟ ΟΝΟΜΑ ΤΟΥ ΚΟΜΒΟΥ
} struct_message;

struct_message myData;        // ΔΗΜΙΟΥΡΓΙΑ ΤΟΥ ΠΡΑΓΜΑΤΙΚΟΥ ΧΩΡΟΥ ΜΝΗΜΗΣ ΓΙΑ ΤΟ ΠΑΚΕΤΟ
esp_now_peer_info_t peerInfo; // ΔΗΜΙΟΥΡΓΙΑ ΤΟΥ ΧΩΡΟΥ ΜΝΗΜΗΣ ΓΙΑ ΤΙΣ ΡΥΘΜΙΣΕΙΣ ΤΟΥ ΔΕΚΤΗ

void setup() {
    
    start_time = millis(); // ΚΑΤΑΓΡΑΦΗ ΤΟΥ ΧΡΟΝΟΥ ΕΚΚΙΝΗΣΗΣ (ΧΙΛΙΟΣΤΑ ΤΟΥ ΔΕΥΤΕΡΟΛΕΠΤΟΥ ΑΠΟ ΤΟ ΑΝΑΜΜΑ)

    Serial.begin(115200); // ΕΝΑΡΞΗ ΤΗΣ ΣΕΙΡΙΑΚΗΣ ΣΥΝΔΕΣΗΣ ΓΙΑ ΕΚΤΥΠΩΣΗ ΜΗΝΥΜΑΤΩΝ ΣΤΟΝ ΥΠΟΛΟΓΙΣΤΗ

    WiFi.mode(WIFI_STA); // ΕΝΕΡΓΟΠΟΙΗΣΗ ΤΗΣ ΚΕΡΑΙΑΣ WI-FI ΣΕ ΛΕΙΤΟΥΡΓΙΑ STATION (ΑΠΑΡΑΙΤΗΤΟ ΓΙΑ ESP-NOW)

    Serial.println();                            // ΕΚΤΥΠΩΣΗ ΚΕΝΗΣ ΓΡΑΜΜΗΣ ΓΙΑ ΚΑΛΥΤΕΡΗ ΑΝΑΓΝΩΣΗ
    Serial.println("ESP-NOW END DEVICE STARTED (DHT11 ONLY)"); 

    // ΡΥΘΜΙΣΗ ΑΙΣΘΗΤΗΡΩΝ
    dht.begin();               // ΕΚΚΙΝΗΣΗ ΤΟΥ ΑΙΣΘΗΤΗΡΑ ΘΕΡΜΟΚΡΑΣΙΑΣ ΚΑΙ ΥΓΡΑΣΙΑΣ

    // ΑΡΧΙΚΟΠΟΙΗΣΗ ESP-NOW
    if (esp_now_init() != ESP_OK) {                   // ΕΛΕΓΧΟΣ ΑΝ ΤΟ ΣΥΣΤΗΜΑ ESP-NOW ΞΕΚΙΝΑΕΙ ΕΠΙΤΥΧΩΣ
        Serial.println("ΣΦΑΛΜΑ ΑΡΧΙΚΟΠΟΙΗΣΗΣ ESP-NOW"); // ΕΚΤΥΠΩΣΗ ΣΦΑΛΜΑΤΟΣ ΣΕ ΠΕΡΙΠΤΩΣΗ ΑΠΟΤΥΧΙΑΣ
        return;                                       // ΔΙΑΚΟΠΗ ΤΗΣ ΔΙΑΔΙΚΑΣΙΑΣ SETUP ΑΝ ΥΠΑΡΧΕΙ ΣΦΑΛΜΑ
    }

    // ΡΥΘΜΙΣΗ ΔΕΚΤΗ (PEER)
    memcpy(peerInfo.peer_addr, broadcastAddress, 6); // ΑΝΤΙΓΡΑΦΗ ΤΗΣ ΔΙΕΥΘΥΝΣΗΣ BROADCAST ΣΤΙΣ ΡΥΘΜΙΣΕΙΣ ΤΟΥ ΔΕΚΤΗ
    peerInfo.channel = 0;                            // ΡΥΘΜΙΣΗ ΚΑΝΑΛΙΟΥ WI-FI ΣΤΟ 0 (ΠΡΟΕΠΙΛΟΓΗ)
    peerInfo.encrypt = false;                        // ΑΠΟΣΤΟΛΗ ΔΕΔΟΜΕΝΩΝ ΧΩΡΙΣ ΚΡΥΠΤΟΓΡΑΦΗΣΗ

    // ΠΡΟΣΘΗΚΗ ΔΕΚΤΗ (PEER)
    if (esp_now_add_peer(&peerInfo) != ESP_OK) { // ΠΡΟΣΠΑΘΕΙΑ ΠΡΟΣΘΗΚΗΣ ΤΟΥ ΔΕΚΤΗ ΣΤΗ ΛΙΣΤΑ ΣΥΝΔΕΣΕΩΝ
        Serial.println("ΑΠΟΤΥΧΙΑ ΠΡΟΣΘΗΚΗΣ ΔΕΚΤΗ");    // ΕΚΤΥΠΩΣΗ ΣΦΑΛΜΑΤΟΣ ΑΝ ΔΕΝ ΜΠΟΡΕΙ ΝΑ ΠΡΟΣΤΕΘΕΙ Ο ΔΕΚΤΗΣ
        return;                                  // ΔΙΑΚΟΠΗ ΑΝ ΑΠΟΤΥΧΕΙ
    }

    // =====================================
    // ΔΙΑΜΟΡΦΩΣΗ ΠΑΡΑΜΕΤΡΩΝ ΚΟΜΒΟΥ
    // =====================================

    myData.node_id = 15;            // ΟΡΙΣΜΟΣ ΤΟΥ ΜΟΝΑΔΙΚΟΥ ΜΑΣ ΑΡΙΘΜΟΥ ΣΥΣΚΕΥΗΣ ΣΕ 15
    strcpy(myData.text, "NODE_15"); // ΑΝΤΙΓΡΑΦΗ ΤΟΥ ΚΕΙΜΕΝΟΥ "NODE_15" ΣΤΟ ΠΑΚΕΤΟ
    
    // ΦΟΡΤΩΣΗ ΜΕΤΡΗΤΗ ΑΠΟ ΤΗ ΜΝΗΜΗ RTC
    myData.packet_counter = rtc_packet_counter; // ΕΠΑΝΑΦΟΡΑ ΤΟΥ ΑΡΙΘΜΟΥ ΠΑΚΕΤΩΝ ΑΠΟ ΤΗΝ ΕΙΔΙΚΗ ΜΝΗΜΗ ΥΠΝΟΥ
}

void loop() {
    // =====================================
    // ΑΝΑΓΝΩΣΗ ΤΙΜΩΝ ΑΙΣΘΗΤΗΡΑ
    // =====================================
    
    delay(2000);  // ΑΝΑΜΟΝΗ ΓΙΑ ΣΤΑΘΕΡΟΠΟΙΗΣΗ ΤΟΥ DHT11 (ΤΟΥ ΔΙΝΟΥΜΕ 2 ΔΕΥΤΕΡΟΛΕΠΤΑ ΝΑ ΖΕΣΤΑΘΕΙ)
    float temp = dht.readTemperature(); // ΑΝΑΓΝΩΣΗ ΤΗΣ ΘΕΡΜΟΚΡΑΣΙΑΣ ΚΑΙ ΑΠΟΘΗΚΕΥΣΗ ΣΤΗ ΜΕΤΑΒΛΗΤΗ 'temp'
    float hum = dht.readHumidity();     // ΑΝΑΓΝΩΣΗ ΤΗΣ ΥΓΡΑΣΙΑΣ ΚΑΙ ΑΠΟΘΗΚΕΥΣΗ ΣΤΗ ΜΕΤΑΒΛΗΤΗ 'hum'

    // =====================================
    // ΣΥΜΠΛΗΡΩΣΗ ΠΑΚΕΤΟΥ
    // =====================================

    // ΕΠΙΚΥΡΩΣΗ ΤΙΜΩΝ ΑΙΣΘΗΤΗΡΑ ΚΑΙ ΑΝΑΘΕΣΗ ΣΤΟ ΠΑΚΕΤΟ
    myData.value1 = (isnan(temp) || temp < 0 || temp > 50) ? 0.0 : temp; // ΘΕΡΜΟΚΡΑΣΙΑ (ΜΗΔΕΝΙΣΜΟΣ ΑΝ Η ΜΕΤΡΗΣΗ ΕΙΝΑΙ ΕΣΦΑΛΜΕΝΗ)
    myData.value2 = (isnan(hum) || hum < 20 || hum > 90) ? 0.0 : hum;    // ΥΓΡΑΣΙΑ (ΜΗΔΕΝΙΣΜΟΣ ΑΝ Η ΜΕΤΡΗΣΗ ΕΙΝΑΙ ΕΣΦΑΛΜΕΝΗ)
    myData.value3 = 0.0;                                                 // ΑΠΟΣΤΑΣΗ (ΜΗΔΕΝ ΕΠΕΙΔΗ ΔΕΝ ΥΠΑΡΧΕΙ HC-SR04)
    myData.value4 = 0.0;                                                 // ΑΧΡΗΣΙΜΟΠΟΙΗΤΟ (ΠΑΡΑΜΕΝΕΙ ΚΕΝΟ)

    myData.int2 = WiFi.RSSI(); // ΑΝΑΓΝΩΣΗ ΤΗΣ ΤΟΠΙΚΗΣ ΙΣΧΥΟΣ ΣΗΜΑΤΟΣ WI-FI (ΘΑ ΕΙΝΑΙ 0 ΕΠΕΙΔΗ ΔΕΝ ΣΥΝΔΕΟΜΑΣΤΕ ΣΕ ROUTER)
    
    // ΑΥΞΗΣΗ ΤΟΥ ΜΕΤΡΗΤΗ ΠΑΚΕΤΩΝ ΠΡΙΝ ΤΟ CHECKSUM
    rtc_packet_counter++;                       // ΠΡΟΣΘΗΚΗ 1 ΣΤΟΝ ΜΟΝΙΜΟ ΜΕΤΡΗΤΗ ΠΑΚΕΤΩΝ ΜΑΣ
    myData.packet_counter = rtc_packet_counter; // ΤΟΠΟΘΕΤΗΣΗ ΤΗΣ ΝΕΑΣ ΤΙΜΗΣ ΤΟΥ ΜΕΤΡΗΤΗ ΣΤΟ ΠΑΚΕΤΟ

    // ΥΠΟΛΟΓΙΣΜΟΣ ΑΘΡΟΙΣΜΑΤΟΣ ΕΛΕΓΧΟΥ (ΘΕΡΜΟΚΡΑΣΙΑ + ΥΓΡΑΣΙΑ + ΜΕΤΡΗΤΗΣ)
    myData.int1 = (int32_t)(myData.value1 + myData.value2 + myData.packet_counter); // ΠΡΟΣΘΕΣΗ ΤΙΜΩΝ ΓΙΑ ΤΟΝ ΕΛΕΓΧΟ ΣΦΑΛΜΑΤΩΝ
    
    myData.flag1 = true;  // ΟΡΙΣΜΟΣ ΤΗΣ ΠΡΩΤΗΣ ΣΗΜΑΙΑΣ ΣΕ TRUE
    myData.flag2 = false; // ΟΡΙΣΜΟΣ ΤΗΣ ΔΕΥΤΕΡΗΣ ΣΗΜΑΙΑΣ ΣΕ FALSE

    // --- ΤΟΠΙΚΟΣ ΕΛΕΓΧΟΣ ΔΕΔΟΜΕΝΩΝ ---
    Serial.println("\n--- ΤΟΠΙΚΟΣ ΕΛΕΓΧΟΣ ΔΕΔΟΜΕΝΩΝ ---"); // ΕΚΤΥΠΩΣΗ ΕΠΙΚΕΦΑΛΙΔΑΣ ΓΙΑ ΤΟΝ ΤΟΠΙΚΟ ΜΑΣ ΕΛΕΓΧΟ
    Serial.printf("ΥΠΟΛΟΓΙΣΜΟΣ: %.2f (ΘΕΡΜ.) + %.2f (ΥΓΡ.) + %u (ΜΕΤΡΗΤΗΣ)\n", myData.value1, myData.value2, myData.packet_counter); // ΕΜΦΑΝΙΣΗ ΤΩΝ ΑΚΡΙΒΩΝ ΑΡΙΘΜΩΝ ΠΟΥ ΠΡΟΣΘΕΤΟΥΜΕ
    Serial.printf("ΠΑΡΑΓΟΜΕΝΟ CHECKSUM (INT1): %d\n", myData.int1); // ΕΜΦΑΝΙΣΗ ΤΟΥ ΤΕΛΙΚΟΥ ΑΠΟΤΕΛΕΣΜΑΤΟΣ CHECKSUM
    Serial.printf("ΑΝΑΓΝΩΣΗ RSSI (INT2): %d DBM\n", myData.int2);      // ΕΜΦΑΝΙΣΗ ΤΗΣ ΤΟΠΙΚΗΣ ΤΙΜΗΣ RSSI
    Serial.println("------------------------");                    // ΕΚΤΥΠΩΣΗ ΓΡΑΜΜΗΣ ΚΑΤΑΚΛΕΙΔΑΣ

    // =====================================
    // ΑΠΟΣΤΟΛΗ ΠΑΚΕΤΟΥ (ΜΕ ΜΗΧΑΝΙΣΜΟ ΕΠΑΝΑΛΗΨΗΣ)
    // =====================================
    
    bool send_success = false; // ΜΕΤΑΒΛΗΤΗ ΓΙΑ ΝΑ ΘΥΜΟΜΑΣΤΕ ΑΝ ΤΟ ΠΑΚΕΤΟ ΣΤΑΛΘΗΚΕ ΕΠΙΤΥΧΩΣ
    esp_err_t result;          // ΜΕΤΑΒΛΗΤΗ ΓΙΑ ΝΑ ΚΡΑΤΗΣΕΙ ΤΟ ΑΠΟΤΕΛΕΣΜΑ ΤΗΣ ΕΝΤΟΛΗΣ ΑΠΟΣΤΟΛΗΣ

    // ΠΡΟΣΠΑΘΕΙΑ ΑΠΟΣΤΟΛΗΣ ΕΩΣ 3 ΦΟΡΕΣ
    for (int i = 0; i < 3; i++) { // ΒΡΟΧΟΣ ΕΩΣ 3 ΦΟΡΕΣ
        result = esp_now_send(broadcastAddress, (uint8_t *) &myData, sizeof(myData)); // ΑΠΟΣΤΟΛΗ ΤΟΥ ΠΑΚΕΤΟΥ ΣΕ ΟΛΟΥΣ
        if (result == ESP_OK) {  // ΑΝ Η ΕΝΤΟΛΗ ΑΠΟΣΤΟΛΗΣ ΛΕΙΤΟΥΡΓΗΣΕ
            send_success = true; // ΣΗΜΕΙΩΣΗ ΤΗΣ ΕΠΙΤΥΧΙΑΣ ΩΣ TRUE
            break; // ΕΞΟΔΟΣ ΑΠΟ ΤΟΝ ΒΡΟΧΟ ΑΝ ΠΕΤΥΧΕΙ (ΣΤΑΜΑΤΑΜΕ ΤΙΣ ΠΡΟΣΠΑΘΕΙΕΣ)
        }
        delay(200); // ΑΝΑΜΟΝΗ ΠΡΙΝ ΤΗΝ ΕΠΑΝΑΠΟΣΤΟΛΗ (ΠΑΥΣΗ ΓΙΑ 200 ΧΙΛΙΟΣΤΑ ΤΟΥ ΔΕΥΤΕΡΟΛΕΠΤΟΥ)
    }

    // ΕΚΤΥΠΩΣΗ ΚΑΤΑΣΤΑΣΗΣ
    if (send_success) { // ΑΝ ΤΟ ΠΑΚΕΤΟ ΣΤΑΛΘΗΚΕ ΕΠΙΤΥΧΩΣ
        Serial.print("ΤΟ ΠΑΚΕΤΟ ΣΤΑΛΘΗΚΕ: "); // ΕΚΤΥΠΩΣΗ ΚΕΙΜΕΝΟΥ ΕΠΙΤΥΧΙΑΣ
        Serial.println(myData.packet_counter); // ΕΚΤΥΠΩΣΗ ΤΟΥ ΑΡΙΘΜΟΥ ΠΑΚΕΤΟΥ ΠΟΥ ΣΤΑΛΘΗΚΕ
        Serial.printf("T:%.1f H:%.1f CHK:%d RSSI:%d\n", myData.value1, myData.value2, myData.int1, myData.int2); // ΕΚΤΥΠΩΣΗ ΟΛΩΝ ΤΩΝ ΤΕΛΙΚΩΝ ΤΙΜΩΝ
    } else { // ΑΝ ΤΟ ΠΑΚΕΤΟ ΑΠΕΤΥΧΕ ΜΕΤΑ ΑΠΟ 3 ΠΡΟΣΠΑΘΕΙΕΣ
        Serial.println("ΣΦΑΛΜΑ ΚΑΤΑ ΤΗΝ ΑΠΟΣΤΟΛΗ ΤΟΥ ΠΑΚΕΤΟΥ"); // ΕΚΤΥΠΩΣΗ ΜΗΝΥΜΑΤΟΣ ΣΦΑΛΜΑΤΟΣ
    }

    // =====================================
    // ΥΠΟΛΟΓΙΣΜΟΣ ΧΡΟΝΟΥ ΥΠΝΟΥ & ΕΝΑΡΞΗ DEEP SLEEP
    // =====================================

    uint32_t code_execution_time = millis() - start_time; // ΕΥΡΕΣΗ ΤΟΥ ΧΡΟΝΟΥ ΠΟΥ ΠΕΡΑΣΕ ΑΠΟ ΤΟΤΕ ΠΟΥ ΞΥΠΝΗΣΕ Η ΣΥΣΚΕΥΗ
    uint32_t boot_overhead = 250; // ΧΡΟΝΟΣ ΕΚΚΙΝΗΣΗΣ ΥΛΙΚΟΥ (ΕΚΤΙΜΩΜΕΝΟΣ ΧΡΟΝΟΣ ΓΙΑ ΤΟ ΑΝΑΜΜΑ ΤΗΣ ΠΛΑΚΕΤΑΣ)
    uint32_t total_active_time = code_execution_time + boot_overhead; // ΠΡΟΣΘΕΣΗ ΧΡΟΝΟΥ ΕΚΚΙΝΗΣΗΣ ΚΑΙ ΧΡΟΝΟΥ ΕΚΤΕΛΕΣΗΣ ΜΑΖΙ

    // OFFSET ΒΑΘΜΟΝΟΜΗΣΗΣ ΓΙΑ ΤΗ ΔΙΟΡΘΩΣΗ ΤΗΣ ΑΠΟΚΛΙΣΗΣ ΤΟΥ ΡΟΛΟΓΙΟΥ ΤΟΥ ESP32
    uint32_t sleep_calibration = 670; // ΠΡΟΣΘΕΤΟΣ ΧΡΟΝΟΣ ΠΟΥ ΠΡΟΣΤΙΘΕΤΑΙ ΓΙΑ ΝΑ ΔΙΟΡΘΩΣΕΙ ΤΗΝ ΤΑΧΥΤΗΤΑ ΤΟΥ ΕΣΩΤΕΡΙΚΟΥ ΡΟΛΟΓΙΟΥ
    
    // ΣΤΟΧΟΣ ΚΥΚΛΟΥ ΥΠΝΟΥ ΕΙΝΑΙ ΤΑ 60 ΔΕΥΤΕΡΟΛΕΠΤΑ (60000 MS)
    uint32_t sleep_time_ms = 60000; // ΘΕΛΟΥΜΕ Η ΣΥΣΚΕΥΗ ΝΑ ΚΟΙΜΗΘΕΙ ΓΙΑ 60 ΔΕΥΤΕΡΟΛΕΠΤΑ

    if (total_active_time < 60000) { // ΑΝ Ο ΕΝΕΡΓΟΣ ΧΡΟΝΟΣ ΜΑΣ ΕΙΝΑΙ ΜΙΚΡΟΤΕΡΟΣ ΑΠΟ 60 ΔΕΥΤΕΡΟΛΕΠΤΑ (ΤΟ ΟΠΟΙΟ ΕΙΝΑΙ ΦΥΣΙΟΛΟΓΙΚΟ)
        sleep_time_ms = (60000 - total_active_time) + sleep_calibration; // ΥΠΟΛΟΓΙΣΜΟΣ ΑΚΡΙΒΟΥΣ ΧΡΟΝΟΥ ΥΠΝΟΥ ΠΟΥ ΑΠΟΜΕΝΕΙ ΚΑΙ ΠΡΟΣΘΗΚΗ ΤΗΣ ΔΙΟΡΘΩΣΗΣ
    }

    Serial.print("\nΕΝΕΡΓΟΣ ΧΡΟΝΟΣ: ");      // ΕΚΤΥΠΩΣΗ ΚΕΙΜΕΝΟΥ ΓΙΑ ΤΟΝ ΕΝΕΡΓΟ ΧΡΟΝΟ
    Serial.print(total_active_time);      // ΕΚΤΥΠΩΣΗ ΤΟΥ ΠΡΑΓΜΑΤΙΚΟΥ ΕΝΕΡΓΟΥ ΧΡΟΝΟΥ ΣΕ ΧΙΛΙΟΣΤΑ ΤΟΥ ΔΕΥΤΕΡΟΛΕΠΤΟΥ
    Serial.print(" MS | ΥΠΝΟΣ ΓΙΑ: "); // ΕΚΤΥΠΩΣΗ ΚΕΙΜΕΝΟΥ ΓΙΑ ΤΟΝ ΧΡΟΝΟ ΥΠΝΟΥ
    Serial.print(sleep_time_ms);          // ΕΚΤΥΠΩΣΗ ΤΟΥ ΠΡΑΓΜΑΤΙΚΟΥ ΧΡΟΝΟΥ ΥΠΝΟΥ ΣΕ ΧΙΛΙΟΣΤΑ ΤΟΥ ΔΕΥΤΕΡΟΛΕΠΤΟΥ
    Serial.println(" MS");                // ΕΚΤΥΠΩΣΗ ΜΟΝΑΔΩΝ ΚΑΙ ΑΛΛΑΓΗ ΓΡΑΜΜΗΣ
    Serial.flush(); // ΑΝΑΜΟΝΗ ΓΙΑ ΤΟΝ ΤΕΡΜΑΤΙΣΜΟ ΤΗΣ ΣΕΙΡΙΑΚΗΣ (ΕΞΑΣΦΑΛΙΣΗ ΟΤΙ ΟΛΟ ΤΟ ΚΕΙΜΕΝΟ ΕΧΕΙ ΕΚΤΥΠΩΘΕΙ ΠΡΙΝ ΤΟΝ ΥΠΝΟ)
    // ΔΙΝΩ 2" ΓΙΑ ΝΑ ΦΑΝΕΙ ΣΤΟ ΜΟΝΙΤΟΡ ΟΙ ΜΕΤΡΗΣΕΙΣ
    delay(2000);
    // ΡΥΘΜΙΣΗ ΧΡΟΝΟΜΕΤΡΟΥ ΚΑΙ ΕΙΣΟΔΟΣ ΣΕ DEEP SLEEP
    // ΜΕΙΩΝ 2000MS ΑΠΟ ΤΟ ΞΥΠΝΗΤΗΡΙ ΓΙΑ ΜΗΝ ΧΑΛΑΣΕΙ ΤΟ 60"
    esp_sleep_enable_timer_wakeup((sleep_time_ms - 2000)* 1000ULL); // ΡΥΘΜΙΣΗ ΤΟΥ ΞΥΠΝΗΤΗΡΙΟΥ ΣΕ ΜΙΚΡΟΔΕΥΤΕΡΟΛΕΠΤΑ (MS * 1000)
    esp_deep_sleep_start(); // ΘΕΣΗ ΤΟΥ ESP32 ΣΕ ΒΑΘΥ ΥΠΝΟ ΓΙΑ ΕΞΟΙΚΟΝΟΜΗΣΗ ΜΠΑΤΑΡΙΑΣ
}